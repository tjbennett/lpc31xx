## arch/arm/mach-lpc31xx/Kconfig
```kconfig
menu "LPC31xx Implementations"
	depends on ARCH_LPC31XX

choice
	prompt "LPC31xx Platform type"
	default MACH_EA313X

config MACH_EA313X
	bool "ea313x board"
	help
	  Say Y here if you are using the Embedded Artist's EA313x board

config MACH_EA3152
	bool "ea3152 board"
	select LPC3152_AD
	help
	  Say Y here if you are using Embedded Artist's EA3152 board
	  
endchoice

config LPC3152_AD
	bool

source "kernel/Kconfig.hz"

endmenu
```

## drivers/misc/lpc31xx/Kconfig
```kconfig
menuconfig NEW_LPC31xx_IO
	bool "NxP lpc31xx IO drivers (ADC, PWM, ...)"
	help
	  Say Y to enable support for lpc31xx series MCU's on-chip peripherials like AD-converter and Pulse Width Modulator..

if NEW_LPC31xx_IO

config LPC31xx_ADC
	tristate "lpc31xx ADC support"
	help
	  Say Y to enable the ADC driver, when built as a module, the module will be called "lpc31xx_adc".
	  
config LPC31xx_PWM
	tristate "lpc31xx PWM support"
	help
	   Say Y to enable the PWM driver, when built as a moule, the module will be called "lpc31xx_pwm".

endif
```
