/*
 * lpc3131.dtsi - Device Tree Include file for LPC3131 family SoC
 *
 *  Copyright (C) 2011 Jon Smirl <jonsmirl@gmail.com>
 *
 * Licensed under GPLv2.
 */

/include/ "lpc3130.dtsi"

/ {
	model = "NXP LPC3131 SoC";
	compatible = "nxp,lpc3131";
	
	isram0: memory@11028000 {
		reg = <0x11028000 0x18000>;
		interrupts = <28>;
	};
};
